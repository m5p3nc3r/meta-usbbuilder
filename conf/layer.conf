## conf/layer.conf
```bitbake
# We have a conf and classes directory, add to BBPATH
BBPATH .= ":${LAYERDIR}"

# We have recipes-* directories, add to BBFILES
BBFILES += "${LAYERDIR}/recipes-*/*/*.bb \
            ${LAYERDIR}/recipes-*/*/*.bbappend"

BBFILES_odroid-c2 += "${LAYERDIR}/odroid-c2/recipes-*/*/*.bb \
                      ${LAYERDIR}/odroid-c2/recipes-*/*/*.bbappend"

BBFILES_raspberrypi4-64 += "${LAYERDIR}/raspberrypi4-64/recipes-*/*/*.bb \
                            ${LAYERDIR}/raspberrypi4-64/recipes-*/*/*.bbappend"


BBFILE_COLLECTIONS += "usbbuilder"
BBFILE_PATTERN_usbbuilder = "^${LAYERDIR}/"
BBFILE_PRIORITY_usbbuilder = "5"
LAYERVERSION_usbbuilder = "3"

LAYERSERIES_COMPAT_usbbuilder = "sumo thud warrior zeus"
```
